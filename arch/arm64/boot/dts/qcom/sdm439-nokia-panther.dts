// SPDX-License-Identifier: GPL-2.0-only

/dts-v1/;

#include "sdm439.dtsi"

/ {
    model = "Nokia 4.2";
    compatible = "nokia,panther", "qcom,sdm439";

    /* required for bootloader to select correct board */
    qcom,msm-id = <0x161 0x00>;
    qcom,pmic-id = <0x10016 0x25 0x00 0x00>;

    aliases {
    };

    chosen {
        bootargs = "earlycon=tty0 console=tty0";

        #address-cells = <2>;
		#size-cells = <2>;
		ranges;

		stdout-path = "framebuffer0";

		framebuffer0: framebuffer@9d400000 {
			compatible = "simple-framebuffer";
			reg = <0 0x90001000 0 (1520 * 720 * 4)>;
			width = <720>;
			height = <1520>;
			stride = <(720 * 4)>;
			format = "a8r8g8b8";
			status= "okay";
		};
    };
};